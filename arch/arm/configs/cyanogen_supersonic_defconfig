## drivers/media/video/msm/Kconfig
```kconfig
comment "Qualcomm MSM Camera And Video"

menuconfig MSM_CAMERA
	bool "Qualcomm MSM camera and video capture support"
	depends on ARCH_MSM
	help
	  Say Y here to enable selecting the video adapters for
	  Qualcomm msm camera and video encoding

config 720P_CAMERA
	bool "Qualcomm MSM camera with 720P video support"
	depends on MSM_CAMERA
	help
	  720P video support

config MSM_CAMERA_V4L2
	bool "Video For Linux interface to MSM camera"
	depends on MSM_CAMERA && VIDEO_V4L2 && EXPERIMENTAL
	help
	  Say Y here to enable the V4L2 interface for the MSM camera.
	  Not everything works through this interface and it has not
	  been thoroughly tested.

config MSM_CAMERA_DEBUG
	bool "Qualcomm MSM camera debugging with printk"
	depends on MSM_CAMERA
	help
	  Enable printk() debug for msm camera

comment "Camera Sensor Selection"
config MT9T013
	bool "Sensor mt9t013 (BAYER 3M)"
	depends on MSM_CAMERA
	---help---
	  MICRON 3M Bayer Sensor with AutoFocus

config MT9D112
	bool "Sensor mt9d112 (YUV 2M)"
	depends on MSM_CAMERA
	---help---
	  MICRON 2M YUV Sensor

config MT9P012
	bool "Sensor mt9p012 (BAYER 5M)"
	depends on MSM_CAMERA
	---help---
	  MICRON 5M Bayer Sensor with Autofocus

config MSM_CAMERA_AF_FOXCONN
	bool "FOXCONN Module"
	depends on MT9P012
	---help---
	  This driver supports FOXCONN AF module for 5M Bayer sensor

config S5K3E2FX
	bool "Sensor s5k3e2fx (Samsung 5M)"
	depends on MSM_CAMERA
	---help---
	  Samsung 5M with Autofocus

config S5K6AAFX
	bool "Sensor s5k6aafx (Samsung 1.3M)"
	depends on MSM_CAMERA
	default n
	---help---
	  Samsung 1.3M without Autofocus

config OV8810
	bool "Sensor ov8810"
	depends on MSM_CAMERA
	default n
	---help---
	  OmniVision 8M Bayer Sensor

config OV9665
	bool "Sensor ov9665"
	depends on MSM_CAMERA
	default n
	---help---
	  OmniVision 3M YUV Sensor

config S5K3H1GX
	bool "Sensor s5k3h1gx"
	depends on MSM_CAMERA
	default n
	---help---
	  Samsung 8M 3H1 MIPI AF Sensor
```

## drivers/video/msm/Kconfig
```kconfig
config FB_MSM
	tristate "MSM Framebuffer"
	depends on FB && ARCH_MSM
	select FB_CFB_FILLRECT
	select FB_CFB_COPYAREA
	select FB_CFB_IMAGEBLIT
	default y

config FB_MSM_MDP_PPP
	bool "MSM MDP PPP"
	depends on FB_MSM_LEGACY_MDP
	default y

config FB_MSM_LCDC
	bool "Support for integrated LCD controller in MDP3/4"
	depends on FB_MSM && (MSM_MDP31 || MSM_MDP302 || MSM_MDP40)
	default y

config FB_MSM_MDDI
	bool "Support for MSM MDDI controllers"
	depends on FB_MSM
	default y

config FB_MSM
	tristate
	depends on FB && ARCH_MSM
	select FB_CFB_FILLRECT
	select FB_CFB_COPYAREA
	select FB_CFB_IMAGEBLIT
	default y

config FB_MSM_LEGACY_MDP
	bool "MSM Legacy MDP (qsd8k)"
	depends on FB_MSM && (MSM_MDP30 || MSM_MDP31 || MSM_MDP302)
	default y

config FB_MSM_MDP_PPP
	bool "MSM MDP PPP"
	depends on FB_MSM_LEGACY_MDP
	default y

config FB_MSM_LCDC
	bool "Support for integrated LCD controller in qsd8x50 ,MSM7x27 and MSM7x30"
	depends on FB_MSM && (MSM_MDP31 || MSM_MDP302 || MSM_MDP40)
	default y

config FB_MSM_MDDI
	bool "Support for MSM MDDI controllers"
	depends on FB_MSM
	default y

config FB_MSM_MDDI_EPSON
	bool "Support for Epson MDDI panels"
	depends on FB_MSM_MDDI
	default n

config FB_MSM_MDDI_NOVTEC
	bool "Support for Novtec MDDI panels"
	depends on FB_MSM_MDDI
	default n

config MSM_HDMI
	bool "Support for HDMI in QCT platform"
	depends on MSM_MDP31
	default n

config FB_MSM_LOGO
       bool "Use boot splashscreen"
       depends on FB_MSM
       default y
       help
        Use logo.rle splash screen at startup
```
